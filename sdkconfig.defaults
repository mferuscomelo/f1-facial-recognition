## src/Kconfig.projbuild
```kconfig
menu "F1 FaceCam"

config APP_PUBLISH_URL
    string "URL that receives the JSON events (HTTP POST)"
    default ""
    help
        For example a https://webhook.site inbox (use http://, see README).
        Put it in sdkconfig.defaults.local so it stays out of git.

config APP_LTE_APN
    string "APN of the SIM card"
    default "iot.1nce.net"
    help
        The F1 Starter Kit ships with a 1NCE SIM, which uses iot.1nce.net.

config APP_HEARTBEAT_PERIOD_S
    int "Seconds between heartbeat messages"
    default 300

config APP_PREVIEW
    bool "Live preview over Wi-Fi"
    default y
    help
        The F1 opens its own Wi-Fi network. Join it with a phone or laptop and open
        http://192.168.4.1 to see the camera with the detected faces and register people.
        Camera images are sent to the browser that asks for them, and anyone with the
        Wi-Fi password can change the registered people: change the default password.

config APP_PREVIEW_SSID
    string "Wi-Fi network name"
    default "F1-FaceCam"
    depends on APP_PREVIEW

config APP_PREVIEW_PASSWORD
    string "Wi-Fi password (at least 8 characters)"
    default "f1-facecam"
    depends on APP_PREVIEW
    help
        The default is printed in the README for everyone: set your own in
        sdkconfig.defaults.local so it stays out of git.

endmenu
```
